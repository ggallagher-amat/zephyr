## boards/alif/ensemble_e7_dk/board.yml
```yaml
board:
  name: ensemble_e7_dk
  full_name: Alif Ensemble E7 Development Kit
  vendor: alif
  socs:
  - name: ae722f80f55d5xx
```

## boards/alif/ensemble_e7_dk/ensemble_e7_dk_ae722f80f55d5xx_rtss_he_defconfig
```kconfig
# Copyright (c) 2025 Alif Semiconductor
# SPDX-License-Identifier: Apache-2.0
CONFIG_ARM_MPU=y
CONFIG_HW_STACK_PROTECTION=y

CONFIG_CORTEX_M_SYSTICK=y
CONFIG_XIP=y
CONFIG_FPU=y
CONFIG_FP_HARDABI=y
#CONFIG_SOC_SUPPORT_ARM_MHUV2=y
#CONFIG_CODE_DATA_RELOCATION=y

CONFIG_SERIAL=y
CONFIG_UART_INTERRUPT_DRIVEN=y
CONFIG_UART_NS16550=y
# UART variant of ns16550 that supports auto flow control
CONFIG_UART_NS16550_VARIANT_NS16750=y
CONFIG_RUNTIME_NMI=y

# Cache Management
CONFIG_CACHE_MANAGEMENT=y
```

## boards/amat/calico/board.yml
```yaml
board:
  name: calico
  full_name: AMAT Calico board
  vendor: amat
  socs:
  - name: 'apollo4p'
```

## boards/amat/calico/calico_defconfig
```kconfig
# SPDX-License-Identifier: Apache-2.0
#
# Copyright (c) 2023 Antmicro <www.antmicro.com>

CONFIG_SERIAL=y
CONFIG_CONSOLE=y
CONFIG_UART_CONSOLE=y
CONFIG_UART_INTERRUPT_DRIVEN=y
CONFIG_LOG=y
CONFIG_LOG_BACKEND_UART=y

CONFIG_PINCTRL=y
CONFIG_I2C=y
CONFIG_GPIO=y
CONFIG_REGULATOR=y

CONFIG_SHELL=y
CONFIG_SHELL_BACKEND_SERIAL=y
CONFIG_SHELL_STACK_SIZE=1024
CONFIG_SHELL_BACKEND_SERIAL=n
CONFIG_SHELL_CMDS=y
CONFIG_SHELL_ECHO_STATUS=y
CONFIG_SHELL_HELP=y
CONFIG_SHELL_PRINTF_BUFF_SIZE=30

#shell commands
CONFIG_GPIO_SHELL=y
CONFIG_I2C_SHELL=y
CONFIG_REGULATOR_SHELL=y
```

## boards/amat/margarita/board.yml
```yaml
board:
  name: margarita
  full_name: amat margarita board
  vendor: amat
  socs:
  - name: ae722f80f55d5ls
```

## boards/amat/margarita/margarita_ae722f80f55d5ls_rtss_he_defconfig
```kconfig
# Copyright (c) 2025 Applied Materials Inc.
# SPDX-License-Identifier: Apache-2.0

CONFIG_ARM_MPU=y
CONFIG_HW_STACK_PROTECTION=y

CONFIG_CORTEX_M_SYSTICK=y
CONFIG_XIP=y
CONFIG_FPU=y
CONFIG_FP_HARDABI=y

CONFIG_SERIAL=y
CONFIG_UART_INTERRUPT_DRIVEN=y
CONFIG_UART_NS16550=y
CONFIG_UART_USE_RUNTIME_CONFIGURE=y

# UART variant of ns16550 that supports auto flow control
CONFIG_UART_NS16550_VARIANT_NS16750=y
CONFIG_RUNTIME_NMI=y

# Cache Management
CONFIG_CACHE_MANAGEMENT=y

CONFIG_MAIN_STACK_SIZE=2560
CONFIG_SYSTEM_WORKQUEUE_STACK_SIZE=2048
CONFIG_BT_LONG_WQ_STACK_SIZE=2048
CONFIG_BT_RX_STACK_SIZE=2048

CONFIG_BT_HCI_TX_STACK_SIZE_WITH_PROMPT=y
CONFIG_BT_HCI_TX_STACK_SIZE=1024
CONFIG_ISR_STACK_SIZE=1024
CONFIG_IDLE_STACK_SIZE=128

CONFIG_CONSOLE=y
CONFIG_UART_CONSOLE=y
CONFIG_STDOUT_CONSOLE=y

CONFIG_LOG=y
CONFIG_LOG_DEFAULT_LEVEL=3
CONFIG_SHELL=y

CONFIG_GPIO=y
CONFIG_GPIO_DW=y
CONFIG_GPIO_SHELL=y

CONFIG_BT=y
CONFIG_BT_PERIPHERAL=y
CONFIG_BT_DRIVERS=y
CONFIG_BT_NXP_NW612=y

CONFIG_BT_SMP=y
CONFIG_BT_SIGNING=y
CONFIG_BT_DIS=y
CONFIG_BT_ATT_PREPARE_COUNT=5
CONFIG_BT_BAS=y
CONFIG_BT_HRS=y
CONFIG_BT_IAS=y
CONFIG_BT_CTS=y
CONFIG_BT_CTS_HELPER_API=y
CONFIG_BT_PRIVACY=y
CONFIG_BT_DEVICE_NAME="Margarita_V2"
CONFIG_BT_DEVICE_APPEARANCE=833
CONFIG_BT_DEVICE_NAME_DYNAMIC=y
CONFIG_BT_DEVICE_NAME_MAX=65
CONFIG_BT_MAX_PAIRED=1

#CONFIG_BT_KEYS_OVERWRITE_OLDEST=y
#CONFIG_BT_SETTINGS=y
#CONFIG_FLASH=y
#CONFIG_FLASH_MAP=y
#CONFIG_NVS=y
#CONFIG_SETTINGS=y

CONFIG_BT_BUF_ACL_TX_COUNT=8
CONFIG_BT_H4_NXP_CTLR_WAIT_TIME_AFTER_BAUDRATE_UPDATE=2500
CONFIG_BT_H4_NXP_CTLR_WAIT_TIME_AFTER_UPLOAD=3000
CONFIG_BT_H4_NXP_CTLR_WAIT_HDR_SIG_TIMEOUT=5000
CONFIG_BT_H4_NXP_CTLR_WAIT_TIME_AFTER_UPLOAD=5000
```

## boards/amat/mekong/board.yml
```yaml
board:
  name: mekong
  full_name: AMAT mekong board
  vendor: amat
  socs:
  - name: ae722f80f55d5ls
```

## dts/bindings/amat,gen_gpios.yaml
```yaml
description: GPIO pin for general use, using them for on or off control

compatible: "amat,gen_gpios"

child-binding:
  description: The GPIOs controlling the pin
  properties:
    gpios:
     type: phandle-array
     required: true
    gpio-name:
      type: string
      description: |
        Human readable string describing the gpio.
```

## soc/alif/ensemble/e7/Kconfig
```kconfig
# Copyright (c) 2025 Alif Semiconductor
# SPDX-License-Identifier: Apache-2.0

config SOC_AE722F80F55D5LS_RTSS_HE
	select SOC_FAMILY_ENSEMBLE_RTSS_HE

config SOC_AE722F80F55D5LS_RTSS_HP
	select SOC_FAMILY_ENSEMBLE_RTSS_HP

config SOC_AE722F80F55D5LS_APSS
	select SOC_FAMILY_ENSEMBLE_APSS
```

## soc/alif/ensemble/e7/Kconfig.soc
```kconfig
# Copyright (c) 2025 Alif Semiconductor
# SPDX-License-Identifier: Apache-2.0

config SOC_SERIES_E7
	bool
	select SOC_FAMILY_ENSEMBLE

config SOC_SERIES
	default "e7" if SOC_SERIES_E7

config SOC_AE722F80F55D5LS
	bool
	select SOC_SERIES_E7
	help
	  Alif Ensemble E7

config SOC_AE722F80F55D5LS_RTSS_HE
	bool
	select SOC_AE722F80F55D5LS
	help
	  SOC_AE722F80F55D5LS High Efficiency Real Time Subsystem (RTSS-HE).
	  Cortex-M55 core optimized for power efficiency with a maximum frequency of 160 MHz.

config SOC_AE722F80F55D5LS_RTSS_HP
	bool
	select SOC_AE722F80F55D5LS
	help
	  SOC_AE722F80F55D5LS High Performance Real Time Subsystem (RTSS-HP).
	  Cortex-M55 core optimized for compute performance with a maximum frequency of 400 MHz.

config SOC_AE722F80F55D5LS_APSS
	bool
	select SOC_AE722F80F55D5LS
	help
	   SOC_AE722F80F55D5LS ARM CORTEX-A (APSS).

config SOC
	default "ae722f80f55d5ls" if SOC_AE722F80F55D5LS
```
